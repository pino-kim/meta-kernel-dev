## conf/layer.conf
```bitbake
# We have a conf and classes directory, add to BBPATH
BBPATH .= ":${LAYERDIR}"

# We have recipes-* directories, add to BBFILES
BBFILES += "${LAYERDIR}/recipes-*/*/*.bb \
            ${LAYERDIR}/recipes-*/*/*.bbappend"

BBFILE_COLLECTIONS += "meta-kernel-dev"
BBFILE_PATTERN_meta-kernel-dev = "^${LAYERDIR}/"
BBFILE_PRIORITY_meta-kernel-dev = "6"

LAYERDEPENDS_meta-kernel-dev = "core"
LAYERSERIES_COMPAT_meta-kernel-dev = "warrior zeus"
```

## conf/machine/qemuarm-kdev.conf
```bitbake
#@TYPE: Machine
#@NAME: QEMU Arm Cortex-A15 machine
#@DESCRIPTION: Machine configuration for running an ARMv7 system on QEMU

require conf/machine/qemuarm.conf

SERIAL_CONSOLES ?= "115200;ttyAMA0 115200;hvc0" 

PREFERRED_PROVIDER_virtual/kernel ?= "linux-yocto"
PREFERRED_VERSION_linux-yocto ?= "5.0%"
KBUILD_DEFCONFIG ?= "vexpress_defconfig"
KCONFIG_MODE="--alldefconfig"
```

## conf/machine/qemuarm64-kdev.conf
```bitbake
#@TYPE: Machine
#@NAME: QEMU ARMv8 machine
#@DESCRIPTION: Machine configuration for running an ARMv8 system on QEMU

require conf/machine/qemuarm64.conf

SERIAL_CONSOLES ?= "115200;ttyAMA0 115200;hvc0" 

PREFERRED_PROVIDER_virtual/kernel ?= "linux-yocto"
PREFERRED_VERSION_linux-yocto ?= "5.0%"
KBUILD_DEFCONFIG ?= "defconfig"
KCONFIG_MODE="--alldefconfig"
```

## conf/machine/qemux86-64-kdev.conf
```bitbake
#@TYPE: Machine
#@NAME: QEMU x86-64 machine
#@DESCRIPTION: Machine configuration for running an x86-64 system on QEMU

require conf/machine/qemux86-64.conf

SERIAL_CONSOLES ?= "115200;ttyS0 115200;ttyS1"

PREFERRED_PROVIDER_virtual/kernel ?= "linux-yocto"
PREFERRED_VERSION_linux-yocto ?= "5.0%"
KBUILD_DEFCONFIG ?= "x86_64_defconfig"
KCONFIG_MODE="--alldefconfig"
```

## conf/machine/qemux86-kdev.conf
```bitbake
#@TYPE: Machine
#@NAME: QEMU x86 machine
#@DESCRIPTION: Machine configuration for running an x86 system on QEMU

require conf/machine/qemux86.conf

SERIAL_CONSOLES ?= "115200;ttyS0 115200;ttyS1"

PREFERRED_PROVIDER_virtual/kernel ?= "linux-yocto"
PREFERRED_VERSION_linux-yocto ?= "5.0%"
KBUILD_DEFCONFIG ?= "i386_defconfig"
KCONFIG_MODE="--alldefconfig"
```
